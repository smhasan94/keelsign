/*
 * Host harness for keelsign's MCUboot image-check hook (SHA-62, docs/mcuboot.md).
 *
 *   harness [--slot S] [--slot-size N] [--slot-offset O] [--unmapped] IMAGE
 *
 * Maps IMAGE into image 0's slot S (default 0) of a file-backed flash (flash_stub.c; a
 * slot of N bytes reads 0xFF past the file), O bytes into the slot's flash area (default
 * 0; reads 0xFF before it). For the secondary slot, O is also what the stub
 * boot_get_state_secondary_offset() returns, as MCUboot's loader does under swap using
 * offset (build with -DMCUBOOT_SWAP_USING_OFFSET). Calls boot_image_check_hook(0, S)
 * the way MCUboot's boot_validate_slot() does (FIH_CALL) and prints MCUboot's log
 * lines, then
 *
 *   hook=<REGULAR|FAILURE|SUCCESS|OTHER> status=<n>
 *
 * where status is the keelsign_status_t the hook logged (0 for "verified", -1 if it
 * logged neither). With --unmapped the slot has no flash area (open fails). The trusted
 * keys and the policy are compiled in (keelsign_mcuboot_keys.c, generated by
 * scripts/keelsign_embed_keys.py). Exits 0 when the hook ran and closed every flash area
 * it opened, 2 on a usage or I/O error, 3 if a flash area was left open.
 *
 * Built by tools/repo-checks/tests/mcuboot.rs against a pinned MCUboot checkout:
 * -I mcuboot/hooktest/port -I <mcuboot>/boot/bootutil/include -I mcuboot/include
 * -I keelsign-ffi/include, with <mcuboot>/boot/bootutil/src/fault_injection_hardening.c.
 *
 * SPDX-License-Identifier: MIT OR Apache-2.0
 */
#include <stdint.h>
#include <stdio.h>
#include <stdlib.h>
#include <string.h>

#include "bootutil/boot_hooks.h"
#include "bootutil/fault_injection_hardening.h"

/* flash_stub.c */
int hooktest_map_slot(int slot, const char *path, uint32_t slot_size, uint32_t offset);
int hooktest_open_count(void);
const char *hooktest_last_log(void);

static unsigned long parse_number(const char *text)
{
    char *end = NULL;
    unsigned long value = strtoul(text, &end, 0);
    if (end == text || *end != '\0' || value > 0xFFFFFFFFul) {
        fprintf(stderr, "harness: bad number %s\n", text);
        exit(2);
    }
    return value;
}

/* The keelsign status the hook logged: "... rejected: status N" or "... verified". */
static int logged_status(void)
{
    const char *log = hooktest_last_log();
    const char *at = strstr(log, "rejected: status ");
    if (strncmp(log, "keelsign: ", 10) != 0) {
        return -1;
    }
    if (at != NULL) {
        return atoi(at + strlen("rejected: status "));
    }
    return strstr(log, " verified ") != NULL ? 0 : -1;
}

int main(int argc, char **argv)
{
    int slot = 0, unmapped = 0, i;
    uint32_t slot_size = 0, slot_offset = 0;
    const char *image = NULL;
    const char *verdict;
    FIH_DECLARE(fih_rc, FIH_FAILURE);

    for (i = 1; i < argc; i++) {
        if (strcmp(argv[i], "--slot") == 0 && i + 1 < argc) {
            slot = (int)parse_number(argv[++i]);
        } else if (strcmp(argv[i], "--slot-size") == 0 && i + 1 < argc) {
            slot_size = (uint32_t)parse_number(argv[++i]);
        } else if (strcmp(argv[i], "--slot-offset") == 0 && i + 1 < argc) {
            slot_offset = (uint32_t)parse_number(argv[++i]);
        } else if (strcmp(argv[i], "--unmapped") == 0) {
            unmapped = 1;
        } else if (image == NULL && argv[i][0] != '-') {
            image = argv[i];
        } else {
            image = NULL;
            break;
        }
    }
    if (image == NULL || slot < 0 || slot > 1) {
        fprintf(stderr,
                "usage: harness [--slot 0|1] [--slot-size N] [--slot-offset O] [--unmapped] IMAGE\n");
        return 2;
    }
    if (!unmapped && hooktest_map_slot(slot, image, slot_size, slot_offset) != 0) {
        fprintf(stderr, "harness: cannot open %s\n", image);
        return 2;
    }

    FIH_CALL(boot_image_check_hook, fih_rc, 0, slot);

    if (FIH_EQ(fih_rc, FIH_BOOT_HOOK_REGULAR)) {
        verdict = "REGULAR";
    } else if (FIH_EQ(fih_rc, FIH_FAILURE)) {
        verdict = "FAILURE";
    } else if (FIH_EQ(fih_rc, FIH_SUCCESS)) {
        verdict = "SUCCESS";
    } else {
        verdict = "OTHER";
    }
    printf("hook=%s status=%d\n", verdict, logged_status());
    if (hooktest_open_count() != 0) {
        fprintf(stderr, "harness: %d flash area(s) left open\n", hooktest_open_count());
        return 3;
    }
    return 0;
}
